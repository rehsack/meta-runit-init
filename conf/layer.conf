## conf/layer.conf
```bitbake
# We have a conf and classes directory, add to BBPATH
BBPATH .= ":${LAYERDIR}"

# We have recipes-* directories, add to BBFILES
BBFILES += "${LAYERDIR}/recipes-*/*/*.bb \
	    ${LAYERDIR}/recipes-*/*/*.bbappend"

BBFILE_COLLECTIONS += "runit-init"
BBFILE_PATTERN_runit-init = "^${LAYERDIR}/"
BBFILE_PRIORITY_runit-init = "7"
LAYERVERSION_runit-init = "7"
```

## meta-oe/meta-networking/meta-runit-init-networking/conf/layer.conf
```bitbake
# We have a conf and classes directory, add to BBPATH
BBPATH .= ":${LAYERDIR}"

# We have recipes-* directories, add to BBFILES
BBFILES += "${LAYERDIR}/recipes-*/*/*.bb \
	    ${LAYERDIR}/recipes-*/*/*.bbappend"

BBFILE_COLLECTIONS += "runit-init-networking"
BBFILE_PATTERN_runit-init-networking = "^${LAYERDIR}/"
BBFILE_PRIORITY_runit-init-networking = "7"
LAYERVERSION_runit-init-networking = "7"

LAYERDEPENDS += "runit-init"
LAYERDEPENDS += "networking"
```
